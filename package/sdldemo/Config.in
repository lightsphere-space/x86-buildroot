## package/sdldemo/Config.in
```kconfig
config BR2_PACKAGE_SDLDEMO
    bool "sdldemo"
    depends on BR2_PACKAGE_SDL2
    help
      An SDL program for Buildroot.
```

## package/sdldemo2/Config.in
```kconfig
config BR2_PACKAGE_SDLDEMO2
    bool "sdldemo2"
    depends on BR2_PACKAGE_SDL2
    help
      An SDL program for Buildroot.
```

## package/sdldemo3/Config.in
```kconfig
config BR2_PACKAGE_SDLDEMO3
    bool "sdldemo3"
    depends on BR2_PACKAGE_SDL2
    help
      An SDL program for Buildroot.
```

## package/sdldemo_enum/Config.in
```kconfig
config BR2_PACKAGE_SDLDEMO_ENUM
    bool "sdldemo_enum"
    depends on BR2_PACKAGE_SDL2
    help
      An SDL program for Buildroot.
```

## proj/x86_64/linux_defconfig
```kconfig
BR2_x86_64=y
BR2_PACKAGE_HOST_LINUX_HEADERS_CUSTOM_6_6=y
BR2_GLOBAL_PATCH_DIR="board/qemu/patches"
BR2_DOWNLOAD_FORCE_CHECK_HASHES=y
BR2_SYSTEM_DHCP="eth0"
BR2_ROOTFS_POST_BUILD_SCRIPT="board/qemu/x86_64/post-build.sh"
BR2_ROOTFS_POST_IMAGE_SCRIPT="board/qemu/post-image.sh"
BR2_ROOTFS_POST_SCRIPT_ARGS="$(BR2_DEFCONFIG)"
BR2_LINUX_KERNEL=y
BR2_LINUX_KERNEL_CUSTOM_VERSION=y
BR2_LINUX_KERNEL_CUSTOM_VERSION_VALUE="6.6.32"
BR2_LINUX_KERNEL_USE_CUSTOM_CONFIG=y
BR2_LINUX_KERNEL_CUSTOM_CONFIG_FILE="board/qemu/x86_64/linux.config"
BR2_LINUX_KERNEL_NEEDS_HOST_LIBELF=y
BR2_TARGET_ROOTFS_EXT2=y
# BR2_TARGET_ROOTFS_TAR is not set
BR2_PACKAGE_HOST_QEMU=y
BR2_PACKAGE_HOST_QEMU_SYSTEM_MODE=y
# CONFIG_GCC_PLUGINS is not set
# CONFIG_LDISC_AUTOLOAD is not set
# CONFIG_VIRTUALIZATION is not set
CONFIG_8139CP=y
CONFIG_ATA=y
CONFIG_ATA_PIIX=y
CONFIG_BLK_DEV_SD=y
CONFIG_CGROUPS=y
CONFIG_DEVTMPFS=y
CONFIG_DEVTMPFS_MOUNT=y
CONFIG_DRM=y
CONFIG_DRM_BOCHS=y
CONFIG_DRM_FBDEV_EMULATION=y
CONFIG_DRM_KMS_HELPER=y
CONFIG_DRM_QXL=y
CONFIG_DRM_SIMPLEDRM=y
CONFIG_DRM_VIRTIO_GPU=y
CONFIG_EXT4_FS=y
CONFIG_FB=y
CONFIG_FB_EFI=y
CONFIG_FB_SIMPLE=y
CONFIG_FB_VESA=y
CONFIG_FRAMEBUFFER_CONSOLE=y
CONFIG_FRAMEBUFFER_CONSOLE_DETECT_PRIMARY=y
CONFIG_FRAMEBUFFER_CONSOLE_LEGACY_ACCELERATION=y
CONFIG_HW_RANDOM_VIRTIO=y
CONFIG_HYPERVISOR_GUEST=y
CONFIG_INET=y
CONFIG_INPUT_EVDEV=y
CONFIG_MODULES=y
CONFIG_MODULE_UNLOAD=y
CONFIG_MOUSE_SYNAPTICS_I2C=y
CONFIG_MOUSE_SYNAPTICS_USB=y
CONFIG_NE2K_PCI=y
CONFIG_NET=y
CONFIG_NETDEVICES=y
CONFIG_PACKET=y
CONFIG_PARAVIRT=y
CONFIG_PCI=y
CONFIG_SCSI_VIRTIO=y
CONFIG_SERIAL_8250=y
CONFIG_SERIAL_8250_CONSOLE=y
CONFIG_TTY=y
CONFIG_VT=y
CONFIG_CONSOLE_TRANSLATIONS=y
CONFIG_VT_CONSOLE=y
CONFIG_VT_CONSOLE_SLEEP=y
CONFIG_HW_CONSOLE=y
CONFIG_VGA_CONSOLE=y
CONFIG_FRAMEBUFFER_CONSOLE=y
CONFIG_SERIAL_DEV_BUS=y
CONFIG_SMP=y
CONFIG_SND=y
CONFIG_SND_HDA_GENERIC=y
CONFIG_SND_HDA_INTEL=y
CONFIG_SOUND=y
CONFIG_SYSVIPC=y
CONFIG_TMPFS=y
CONFIG_TMPFS_POSIX_ACL=y
CONFIG_UNIX=y
CONFIG_UNWINDER_FRAME_POINTER=y
CONFIG_USB_EHCI_HCD=y
CONFIG_USB_STORAGE=y
CONFIG_USB_UHCI_HCD=y
CONFIG_USB_XHCI_HCD=y
CONFIG_VBOXGUEST=n
CONFIG_VHOST_NET=y
CONFIG_VIRTIO_BALLOON=y
CONFIG_VIRTIO_BLK=y
CONFIG_VIRTIO_CONSOLE=y
CONFIG_VIRTIO_INPUT=y
CONFIG_VIRTIO_MMIO=y
CONFIG_VIRTIO_MMIO_CMDLINE_DEVICES=y
CONFIG_VIRTIO_NET=y
CONFIG_VIRTIO_PCI=y
CONFIG_VIRT_DRIVERS=y
```
